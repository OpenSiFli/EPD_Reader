## epdiy-epub/bc-601_v10/hcpu/Kconfig.board
```kconfig
config BSP_USING_BOARD_BC_601_V10
    bool
    select SOC_SF32LB52X
    select BF0_HCPU
    default y

rsource "../Kconfig.board"
```

## epdiy-epub/dfu527/loader/Kconfig.proj
```kconfig
config BF0_HCPU
    bool
    default y
config CUSTOM_MEM_MAP
    bool
    default y
config READER527_RECOVERY
    bool
    default y
```

## epdiy-epub/sf32lb527-oed-e0470a03/lcpu/Kconfig.board
```kconfig
config BSP_USING_BOARD_SF32LB527_OED_E0470A03
    bool
    select SOC_SF32LB52X
    select BF0_LCPU
    default y

rsource "../Kconfig.board"
```
