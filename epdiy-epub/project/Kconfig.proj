## epdiy-epub/project/Kconfig.proj
```kconfig
#APP specific configuration.

comment "------------Project configuration-----------"

config CUSTOM_MEM_MAP
    bool 
	select custom_mem_map
	default y    


choice EPD_EPUB_COLOR_DEPTH
	prompt "Select output framebuffer color depth"
	default EPDIY_EPUB_1BPP if LCD_USING_EPD_OPMO37A3
	default EPDIY_EPUB_4BPP if !LCD_USING_EPD_OPMO37A3
	config EPDIY_EPUB_1BPP
		bool "EPDIY_EPUB_1BPP"
	config EPDIY_EPUB_4BPP
		bool "EPDIY_EPUB_4BPP"    
endchoice

if !BSP_USING_BUILT_LCD
#define the EPD connection type
	config LCD_USING_EPD_SPI
		bool
		default n
	config BSP_LCDC_USING_EPD_8BIT
		def_bool n

#define the EPD module name
	config LCD_USING_OPM060D
		bool
		default n

	config LCD_USING_OPM060D
	    bool 
		default n


#define the touch controller name
	config TSC_USING_FT5446U_V01
		bool
		default n

	config TSC_USING_FT6336U
		bool
		default n

	config TSC_USING_GT967
		bool
		default n


	choice
		prompt "Custom LCD driver"
		default LCD_USING_EPD_YZC085_V100 if BSP_USING_BOARD_SF32_OED_EPD_V11
		default LCD_USING_EPD_YZC085_V100_V12 if BSP_USING_BOARD_SF32_OED_EPD_V12
		
		config LCD_USING_EPD_YZC085_V100_V12
			bool "6.0 rect electronic paper display(EPD YZC085_V1.05 1032x758) for V1.2 board"
			select TSC_USING_GT967 if BSP_USING_TOUCHD
			select LCD_USING_OPM060D
			select BSP_LCDC_USING_EPD_8BIT

		config LCD_USING_EPD_YZC085_V100
			bool "6.0 rect electronic paper display(EPD YZC085_V1.05 1032x758) for V1.1 board"
			select TSC_USING_FT5446U_V01 if BSP_USING_TOUCHD
			select LCD_USING_OPM060D
			select BSP_LCDC_USING_EPD_8BIT

		config LCD_USING_EPD_R7D005
			bool "6.0 rect electronic paper display(EPD R7D005_-1.30 1448x1072)"
			select TSC_USING_FT5446U_V01 if BSP_USING_TOUCHD
			select LCD_USING_OPM060D
			select BSP_LCDC_USING_EPD_8BIT

		config LCD_USING_EPD_OPMO37A3
			bool "3.7 rect electronic paper display  SPI (OPM037A3 240x416)"
			select TSC_USING_FT6336U if BSP_USING_TOUCHD
			select LCD_USING_EPD_SPI

	endchoice


	config EPD_WAVEFORM_USE_BIN
	    bool "OPM060D use binary waveform"
		depends on LCD_USING_OPM060D
		default n


    config LCD_HOR_RES_MAX
        int
        default 1448 if LCD_USING_EPD_R7D005
		default 1032 if LCD_USING_EPD_YZC085_V100
		default 1032 if LCD_USING_EPD_YZC085_V100_V12
		default 240 if LCD_USING_EPD_OPMO37A3
    config LCD_VER_RES_MAX
        int
        default 1072 if LCD_USING_EPD_R7D005
		default 758  if LCD_USING_EPD_YZC085_V100
		default 758  if LCD_USING_EPD_YZC085_V100_V12
		default 416  if LCD_USING_EPD_OPMO37A3
    config LCD_DPI
        int
        default 315 if LCD_USING_EPD_R7D005
		default 300 if LCD_USING_EPD_YZC085_V100
		default 300 if LCD_USING_EPD_YZC085_V100_V12
		default 130 if LCD_USING_EPD_OPMO37A3
endif
```

## epdiy-epub/project/Kconfig.tmp
```kconfig
source "D:/Users/gangqiangzhou/Documents/bt1/customer/boards/sf32-oed-ed/hcpu/Kconfig.board"
source "$SIFLI_SDK/customer/boards/Kconfig.v2"
source "$SIFLI_SDK/Kconfig.v2"
rsource "Kconfig.proj"
```

## epdiy-epub/sf32-oed-epd_v12_spi/Kconfig.board
```kconfig
config ASIC
    bool 
    default y 

config TOUCH_PWR_PIN
    int
    default 32

config TOUCH_IRQ_PIN
    int
    default 30

config TOUCH_RESET_PIN
    int
    default 31

    config CHG_STATUS
    int
    default    26

    config TPS_SDA
    int
    default    11
    config TPS_SCL
    int
    default   10

    config EPD_SDA
    int
    default  5
    config EPD_DC
    int
    default  6
    config EPD_RES
    int
    default  0

    config EPD_CS
    int
    default  3
    config EPD_KEY_GPADC
    int
    default  33
    config EPD_KEY1
    int
    default  34
    config EPD_SCK
    int
    default  4
    config EPD_BUSY
    int
    default   7
```

## epdiy-epub/sf32-oed-epd_v12_spi/hcpu/Kconfig.board
```kconfig
config BSP_USING_BOARD_SF32_OED_EPD_V12_SPI
    bool
    select SOC_SF32LB52X
    select BF0_HCPU
    default y

rsource "../Kconfig.board"
```

## opm060e9_reader/project/Kconfig.proj
```kconfig
#APP specific configuration.
config CUSTOM_MEM_MAP
    bool 
	select custom_mem_map
	default y    

choice EPD_DRIVER_METHOD
	prompt "Select EPD driver"
	default EPD_DRIVER_SOFTWARE
	config EPD_DRIVER_SOFTWARE
		bool "Drive EPD with software(Using GPIO to generate waveform)"
	config EPD_DRIVER_LCDC
		bool "Drive EPD with LCDC(HW accelerating with LCDC)"
endchoice
```

## opm060e9_reader/project/Kconfig.tmp
```kconfig
source "D:/work/SDK_master_3/customer/boards/em-lb525_epd/hcpu/Kconfig.board"
source "$SIFLI_SDK/customer/boards/Kconfig.v2"
source "$SIFLI_SDK/Kconfig.v2"
rsource "Kconfig.proj"
```
